/*                KEY POSITIONS

  ╭─────────────────────────╮   ╭─────────────────────────╮
  │ LT5 LT4 LT3 LT2 LT1 LT0 │   │ RT0 RT1 RT2 RT3 RT4 RT5 │
  │ LM5 LM4 LM3 LM2 LM1 LM0 │   │ RM0 RM1 RM2 RM3 RM4 RM5 │
  │ LB5 LB4 LB3 LB2 LB1 LB0 │   │ RB0 RB1 RB2 RB3 RB4 RB5 │
  ╰───────────╮ LH2 LH1 LH0 │   │ RH0 RH1 RH2 ╭───────────╯
              ╰─────────────╯   ╰─────────────╯ */

#define COMBO_TERM_FAST 20
#define COMBO_TERM_SLOW 30

#define COMBO_IDLE_FAST 150
#define COMBO_IDLE_SLOW 50

#define TAPPING_TERM_MS 200
#define QUICK_TAP_MS 175

&num_word {
  continue-list = <BSPC SPACE DEL DOT COMMA PLUS MINUS STAR CARET FSLH EQUAL>;
};

ZMK_MOD_MORPH(lshft,
    bindings = <&kp LSHFT>, <&caps_word>;
    mods = <MOD_RSFT>;
)

ZMK_MOD_MORPH(rshft,
    bindings = <&kp RSHFT>, <&caps_word>;
    mods = <MOD_LSFT>;
)

// tap: key 2 | quick tap: key 2 | hold: key 1 
ZMK_HOLD_TAP(qlt,
    flavor = "balanced";
    tapping-term-ms = <TAPPING_TERM_MS>;
    quick-tap-ms = <200>;
    bindings = <&mo>, <&kp>;
)

// Sticky mods with quick release
ZMK_STICKY_KEY(skm,
    release-after-ms = <3500>;
    bindings = <&kp>;
    quick-release;
    ignore-modifiers;
)

// implements alt+tab behavior
ZMK_TRI_STATE(alt_tab,
    bindings = <&kt RGUI>, <&kp TAB>, <&kt RGUI>;
    ignored-key-positions = <RM0 RM1 RM2 RM3>;   // Ignore Arrows 
)

// tap: play/pause | double-tap: next song | tripple-tap: previous song
ZMK_TAP_DANCE(play_np,
    tapping-term-ms = <300>;
    bindings = <&kp C_PLAY_PAUSE>, <&kp C_NEXT>, <&kp C_PREVIOUS>;
)

// tap: num-word | double-tap: sticky num-layer | hold: num-layer
ZMK_HOLD_TAP(smart_num,
    flavor = "balanced";
    tapping-term-ms = <TAPPING_TERM_MS>;
    quick-tap-ms = <QUICK_TAP_MS>;
    bindings = <&mo>, <&num_dance>;
)

ZMK_TAP_DANCE(num_dance,
    tapping-term-ms = <TAPPING_TERM_MS>;
    bindings = <&num_word NUM>, <&sl NUM>;  // reverse this for sticky-num on single tap
)

// Cyrillic alphabet combos
ZMK_COMBO(sh, &kp LBKT, LT2 LT1, DEF, COMBO_TERM_FAST, COMBO_IDLE_FAST)
ZMK_COMBO(sht, &kp RBKT, LM2 LM1, DEF, COMBO_TERM_FAST, COMBO_IDLE_FAST)
ZMK_COMBO(ch, &kp GRAVE, LB2 LB1, DEF, COMBO_TERM_FAST, COMBO_IDLE_FAST)
ZMK_COMBO(yu, &kp BSLH, RT2 RT1, DEF, COMBO_TERM_FAST, COMBO_IDLE_FAST)

/* vim: set ft=c tw=174: */
