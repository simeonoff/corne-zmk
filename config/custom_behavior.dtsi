/ {
    behaviors {
        swapper: swapper {
            compatible = "zmk,behavior-tri-state";
            #binding-cells = <0>;
            bindings = <&kt RGUI>, <&kp TAB>, <&kt RGUI>;  // Cmd, Tab, and release Cmd
            ignored-key-positions = <7 9 16 17 18 19 29>;   // Ignore arrows, BSPC, ENTER, DEL
        };
    };
};
